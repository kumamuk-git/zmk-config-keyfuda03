## config/west.yml
```yaml
manifest:
  remotes:
    - name: zmkfirmware
      url-base: https://github.com/zmkfirmware
    - name: sekigon-gonnoc
      url-base: https://github.com/sekigon-gonnoc
    - name: kumamuk-git
      url-base: https://github.com/kumamuk-git
    # Additional modules containing boards/shields/custom code can be listed here as well
    # See https://docs.zephyrproject.org/3.2.0/develop/west/manifest.html#projects
  projects:
    - name: zmk
      remote: kumamuk-git
      revision: main
      import: app/west.yml
    - name: zmk-component-ble-micro-pro
      remote: sekigon-gonnoc
      revision: main
  self:
    path: config
```
